## build/Kconfig/Kconfig.shield.defconfig
```kconfig
osource "/Users/theomigod/others/light_switch/boards/shields/*/Kconfig.defconfig"
osource "/Users/theomigod/light/boards/shields/*/Kconfig.defconfig"
osource "/Users/theomigod/light_switch/boards/shields/*/Kconfig.defconfig"
osource "/opt/nordic/ncs/v2.9.0/nrf/boards/shields/*/Kconfig.defconfig"
```

## build/light_switch/Kconfig/Kconfig.shield
```kconfig
osource "/Users/theomigod/others/light_switch/boards/shields/*/Kconfig.shield"
osource "/Users/theomigod/light/boards/shields/*/Kconfig.shield"
osource "/Users/theomigod/light_switch/boards/shields/*/Kconfig.shield"
osource "/opt/nordic/ncs/v2.9.0/nrf/boards/shields/*/Kconfig.shield"
```
